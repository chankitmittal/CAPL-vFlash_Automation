/*@!Encoding:1252*/
includes
{
  #include "VFlash_Utilities.cin"
  #include "Diag_Lib.cin"
}

variables
{
  diagRequest ECM.EcuIdentification_Read read_ecu_identification;
  diagRequest ECM.SerialNumber_Read read_serial_number;
}

void MainTest ()
{ 
  /* 
    VflashPack Name: "temp_flashpack_name.vflashpack"
    Maximum Flash duration: 300s
  */
  singleFlash_Test("temp_flashpack_name.vflashpack", 300);
  /* 
    VflashPack Name: "temp_flashpack_name.vflashpack"
    Flash times: 5
    Maximum Flash duration: 300s
  */
  MultiFlash_Test("temp_flashpack_name.vflashpack", 5, 300);
  /* 
    VflashPack Name: "temp_flashpack_name.vflashpack"
    Expected corruption reason: "Signature"
  */
  Flash_corrupted_SW("temp_flashpack_name_signature_corrupt.vflashpack", "Signature");
  /* 
    VflashPack Name: "temp_flashpack_name.vflashpack"
    Expected corruption reason: "Checksum"
  */
  Flash_corrupted_SW("temp_flashpack_name_checksum_corrupt.vflashpack", "Checksum");
  /*
  Diagnostic service test - ECU Identification
  */
  DiagRequest_Test(read_ecu_identification);
  /*
  Diagnostic service test - Serial Number
  */
  DiagRequest_Test(read_serial_number);
}

testcase singleFlash_Test(char flashpack_file[], long flash_max_time)
{
  /* 
  singleFlash_Test - This function is for one time flashing test.
  This Function takes 2 arguments:
    1. VFlash pack file name -> *.vflashpack
    2. Maximum time flashing shall takes in seconds -> 200s,300s,....
  */
  enum vFlashStatusCode result;
  long flash_start_time = 0, flash_end_time = 0;
  long total_flash_time = 0;
  // Flash start time in seconds
  flash_start_time = timeNow()/100000;
  // Flash VflashPack using TestWaitForvFlashPackReporgrammed function
  result = TestWaitForvFlashPackReprogrammed(flashpack_file);
  // Check if flashing is successful or not
  if(result != Success)
  {
    // Flashing is failed
    testStepFail("Flash Status", "Reprogramming Failed. See Test Report for the more information.");
  }
  else
  {
    // Flashing is successful
    testStepPass("Flash Status", "Software is successfully flashed.");
  }
  // Flash end time in seconds
  flash_end_time = timeNow()/100000;
  // total time flashing took
  total_flash_time = flash_end_time - flash_start_time;
  // Check if it under defined flash time
  if(total_flash_time <= flash_max_time)
  {
    testStepPass("Flashing Time", "Calculated Flashed time is under/equal to Maximum Flash time (%d s). Observed Flash time - %d s.", flash_max_time, total_flash_time);
  }
  else
  {
    testStepFail("Flashing Time", "Calculated Flashed time excedded to Maximum Flash time (%d s). Observed Flash time - %d s.", flash_max_time, total_flash_time);
  }
}

testcase MultiFlash_Test(char flashpack_file[], int num_time, long flash_max_time)
{
  /* 
  MultiFlash_Test - This function is for multiple flashing test.
  This Function takes 3 arguments:
    1. VFlash pack file name -> *.vflashpack
    2. Number of times flashing needs to be repeated -> 5,10,15,... times
    3. Maximum time flashing shall takes in seconds -> 200s,300s,....
  */
  enum vFlashStatusCode result;
  int i = 0;
  long flash_start_time = 0, flash_end_time = 0;
  long total_flash_time = 0;
  for(i= 0; i < num_time; i++)
  {
    // Flash iteration number
    teststep("Flash Iteration", "Count number - %d", i+1);
    // Flash start time in seconds
    flash_start_time = timeNow()/100000;
    // Flash VflashPack using TestWaitForvFlashPackReporgrammed function
    result = TestWaitForvFlashPackReprogrammed(flashpack_file);
    // Check if flashing is successful or not
    if(result != Success)
    {
      // Flashing is failed
      testStepFail("Flash Status", "Reprogramming Failed. See Test Report for the more information.");
    }
    else
    {
      // Flashing is successful
      testStepPass("Flash Status", "Software is successfully flashed.");
    }
    // Flash end time in seconds
    flash_end_time = timeNow()/100000;
    // total time flashing took
    total_flash_time = flash_end_time - flash_start_time;
    // Check if it under defined flash time
    if(total_flash_time <= flash_max_time)
    {
      testStepPass("Flashing Time", "Calculated Flashed time is under/equal to Maximum Flash time (%d s). Observed Flash time - %d s.", flash_max_time, total_flash_time);
    }
    else
    {
      testStepFail("Flashing Time", "Calculated Flashed time excedded to Maximum Flash time (%d s). Observed Flash time - %d s.", flash_max_time, total_flash_time);
    }
  }
}

testcase Flash_corrupted_SW(char vflashpack_file[], char expected_error[])
{
  /* 
  Flash_corrupted_SW - This function is for flashing corrupted SW vflashpack.
  Return Success -> If Flashing is failed due to expected reason ; Failure -> If Flashing is successful/ If flashing is failed due to unexpected reason
  This Function takes 2 arguments:
    1. VFlash pack file name -> *.vflashpack
    2. Expected Error text -> "Signature" for signature corrupted vflashpack ; "Checksum" for checksum corrupted vflashpack
  */
  // Flash corrupted Signature/Checksum in VFlashpack file
  TestWaitForCorruptedvFlashPackReprogrammed(vflashpack_file, expected_error);
}


testcase DiagRequest_Test(diagRequest * diagreq)
{
  if(1 == UDS_Request(diagreq))
  {
    testStepPass("Response Received", "Positive Response Received.");
  }
}

