/*@!Encoding:1252*/
includes
{
  #include "VFlash_Utilities.cin"
  #include "Diag_Lib.cin"
}

variables
{
  diagRequest ECM.EcuIdentification_Read read_ecu_identification;
  diagRequest ECM.SerialNumber_Read read_serial_number;
  diagRequest ECM.* request_diagnostic_service;
  byte security_seed_request[2] = {0x27, 0x01};
  int SeedSizeArray = 4;
  int KeySizeArray = 4;
  int SeedSecurityLevel = 0x01;
  int KeySecurityLevel = 0x02;
  byte GetSeedResponse[6];
  byte SeedBytes[4];
  byte SetKeyRequest[6];
  byte KeyBytes[4];
  dword KeyActualSize = 0;
  char EcuName[100] = "ECM";
}

void default_session()
{
  byte request_arr[2] = {0x10, 0x01};
  DiagRequest_via_bytes(request_diagnostic_service, request_arr);
}

void programming_session()
{
  byte request_arr[2] = {0x10, 0x02};
  DiagRequest_via_bytes(request_diagnostic_service, request_arr);
}

void extended_session()
{
  byte request_arr[2] = {0x10, 0x03};
  DiagRequest_via_bytes(request_diagnostic_service, request_arr);
}

void security_access_unlock()
{
  int i = 0;
  int generate_key_status = 0;
  diagResize(request_diagnostic_service, elcount(security_seed_request));
  diagSetPrimitiveData(request_diagnostic_service, security_seed_request, elcount(security_seed_request));
  if(1 == UDS_Request(request_diagnostic_service))
  {
    // Positive Response received and seed is generated
    UDS_Response(request_diagnostic_service, GetSeedResponse);
    // Extract Seed from the response into SeedBytes
    for(i = 0; i < elcount(GetSeedResponse); i++)
    {
      if(i > 1)
      {
        SeedBytes[i-2] = GetSeedResponse[i];
      }
    }
    // Generate Key using the Seed and security.dll file
    // Security.dll is attached under Diagnostic/ISO TP configuration. Refer user manual for the reference.
    generate_key_status = diagGenerateKeyFromSeed(EcuName, SeedBytes, SeedSizeArray, SeedSecurityLevel, "", "", KeyBytes, KeySizeArray, KeyActualSize);
    if(0 == generate_key_status)
    {
      // Key is generated from Seed
      // Prepare Key sent request by adding generated key bytes to the request
      // KeySentRequest -27 02 XX XX XX XX -> XX generated bytes
      for(i = 0 ; i < elcount(SetKeyRequest); i++)
      {
        if(i == 0)
        {
          SetKeyRequest[i] = 0x27;
        }
        else if(i == 1)
        {
          SetKeyRequest[i] = KeySecurityLevel;
        }
        else
        {
          SetKeyRequest[i] = KeyBytes[i];
        }
      }
      diagResize(request_diagnostic_service, elcount(SetKeyRequest));
      diagSetPrimitiveData(request_diagnostic_service, SetKeyRequest, elcount(SetKeyRequest));
      // Send request with key
      if(1 == UDS_Request(request_diagnostic_service))
      {
        testStepPass("Security Unlock Status", "ECU is unlocked !! Generated Key is correct.");
      }
      else
      {
        testStepFail("Security Unlock Status", "ECU is locked. Generated key is not correct.");
      }
    }
    else
    {
      testStepFail("Key Generation", "Unable to generate key. Error code: %d", generate_key_status);
    }
  }
  else
  {
    testStepFail("Seed Generation", "Unable to generate Seed.");
  }
}

void singleTimeFlash(char flashpack_file[], long flash_max_time)
{
  /* 
  singleTimeFlash - This function is for one time flashing test.
  This Function takes 2 arguments:
    1. VFlash pack file name -> *.vflashpack
    2. Maximum time flashing shall takes in seconds -> 200s,300s,....
  */
  enum vFlashStatusCode result;
  long flash_start_time = 0, flash_end_time = 0;
  long total_flash_time = 0;
  // Flash start time in seconds
  flash_start_time = timeNow()/100000;
  // Flash VflashPack using TestWaitForvFlashPackReporgrammed function
  result = TestWaitForvFlashPackReprogrammed(flashpack_file);
  // Check if flashing is successful or not
  if(result != Success)
  {
    // Flashing is failed
    testStepFail("Flash Status", "Reprogramming Failed. See Test Report for the more information.");
  }
  else
  {
    // Flashing is successful
    testStepPass("Flash Status", "Software is successfully flashed.");
  }
  // Flash end time in seconds
  flash_end_time = timeNow()/100000;
  // total time flashing took
  total_flash_time = flash_end_time - flash_start_time;
  // Check if it under defined flash time
  if(total_flash_time <= flash_max_time)
  {
    testStepPass("Flashing Time", "Calculated Flashed time is under/equal to Maximum Flash time (%d s). Observed Flash time - %d s.", flash_max_time, total_flash_time);
  }
  else
  {
    testStepFail("Flashing Time", "Calculated Flashed time excedded to Maximum Flash time (%d s). Observed Flash time - %d s.", flash_max_time, total_flash_time);
  }
}

void MultiTimeFlash(char flashpack_file[], int num_time, long flash_max_time)
{
  /* 
  MultiTimeFlash - This function is for multiple flashing test.
  This Function takes 3 arguments:
    1. VFlash pack file name -> *.vflashpack
    2. Number of times flashing needs to be repeated -> 5,10,15,... times
    3. Maximum time flashing shall takes in seconds -> 200s,300s,....
  */
  enum vFlashStatusCode result;
  int i = 0;
  long flash_start_time = 0, flash_end_time = 0;
  long total_flash_time = 0;
  for(i= 0; i < num_time; i++)
  {
    // Flash iteration number
    teststep("Flash Iteration", "Count number - %d", i+1);
    // Flash start time in seconds
    flash_start_time = timeNow()/100000;
    // Flash VflashPack using TestWaitForvFlashPackReporgrammed function
    result = TestWaitForvFlashPackReprogrammed(flashpack_file);
    // Check if flashing is successful or not
    if(result != Success)
    {
      // Flashing is failed
      testStepFail("Flash Status", "Reprogramming Failed. See Test Report for the more information.");
    }
    else
    {
      // Flashing is successful
      testStepPass("Flash Status", "Software is successfully flashed.");
    }
    // Flash end time in seconds
    flash_end_time = timeNow()/100000;
    // total time flashing took
    total_flash_time = flash_end_time - flash_start_time;
    // Check if it under defined flash time
    if(total_flash_time <= flash_max_time)
    {
      testStepPass("Flashing Time", "Calculated Flashed time is under/equal to Maximum Flash time (%d s). Observed Flash time - %d s.", flash_max_time, total_flash_time);
    }
    else
    {
      testStepFail("Flashing Time", "Calculated Flashed time excedded to Maximum Flash time (%d s). Observed Flash time - %d s.", flash_max_time, total_flash_time);
    }
  }
}

void Flash_corrupted_SW(char vflashpack_file[], char expected_error[])
{
  /* 
  Flash_corrupted_SW - This function is for flashing corrupted SW vflashpack.
  Return Success -> If Flashing is failed due to expected reason ; Failure -> If Flashing is successful/ If flashing is failed due to unexpected reason
  This Function takes 2 arguments:
    1. VFlash pack file name -> *.vflashpack
    2. Expected Error text -> "Signature" for signature corrupted vflashpack ; "Checksum" for checksum corrupted vflashpack
  */
  // Flash corrupted Signature/Checksum in VFlashpack file
  TestWaitForCorruptedvFlashPackReprogrammed(vflashpack_file, expected_error);
}

testcase Single_flash_test()
{
  /* 
    VflashPack Name: "temp_flashpack_name.vflashpack"
    Maximum Flash duration: 300s
  */
  singleTimeFlash("temp_flashpack_name.vflashpack", 300);
}

testcase multi_flash_test()
{
  /* 
    VflashPack Name: "temp_flashpack_name.vflashpack"
    Flash times: 10
    Maximum Flash duration: 300s
  */
  MultiTimeFlash("temp_flashpack_name.vflashpack", 10, 300);
}

testcase flash_corrupt_signature_test()
{
  /* 
    VflashPack Name: "temp_flashpack_name.vflashpack"
    Expected corruption reason: "Signature"
  */
  Flash_corrupted_SW("temp_flashpack_name_signature_corrupt.vflashpack", "Signature");
}

testcase flash_corrupt_checksum_test()
{
  /* 
    VflashPack Name: "temp_flashpack_name.vflashpack"
    Expected corruption reason: "Checksum"
  */
  Flash_corrupted_SW("temp_flashpack_name_checksum_corrupt.vflashpack", "Checksum");
}

testcase read_diagnostic_service_test()
{
  /*
  Diagnostic service test - ECU Identification
  */
  DiagRequest_via_object(read_ecu_identification);
  /*
  Diagnostic service test - Serial Number
  */
  DiagRequest_via_object(read_serial_number);
}

testcase appl_to_reprogramming_session()
{
  default_session();
  testWaitForTimeout(1000);
  extended_session();
  testWaitForTimeout(1000);
  programming_session();
}

testcase reprogramming_to_appl_session()
{
  default_session();
  testWaitForTimeout(1000);
  extended_session();
  testWaitForTimeout(1000);
  programming_session();
  testWaitForTimeout(1000);
  extended_session();
}

void MainTest ()
{
  Single_flash_test();
  multi_flash_test();
  flash_corrupt_signature_test();
  flash_corrupt_checksum_test();
  read_diagnostic_service_test();
  appl_to_reprogramming_session();
  reprogramming_to_appl_session();
}
