/*@!Encoding:1252*/
variables
{
  enum vFlashStatusCode
  {
    InternalError                     = -10, 
    CallbackInSimlationMissing        =  -3, 
    TestFunctionInSimulationCalled    =  -2, 
    Busy                              =  -1, 
    Timeout                           =   0, 
    Success                           =   1,      
    
    // --- FlashResult Errors ---
    FR_InitializationError        = 1010, 
    FR_DeinitializationError      = 1011, 
    FR_InvalidProjectHandle       = 1012, 
    FR_InvalidLicense             = 1013, 
    FR_StopFailed                 = 1020, 
    FR_ProjectInProcessing        = 1021, 
    FR_NoProjectLoaded            = 1030, 
    FR_ProjectPathInvalid         = 1031, 
    FR_InconsistentProject        = 1032, 
    FR_InvalidCallbacks           = 1033, 
    FR_ProcessingFlashwareError   = 1034, 
    FR_ChannelAlreadyInUse        = 1035,        
    FR_NetworkActivationFailed    = 1036,  
    FR_ChannelInvalid             = 1037, 
    FR_NoCanDriverAvailable       = 1040, 
    FR_SoftwareIntegrityCheckFailed = 1045, 
    FR_InvalidCommandOrder        = 1050,  
    FR_FileNotFound               = 1051, 
    FR_ProjectLoadFailed          = 1052, 
    FR_ProjectUnloadFailed        = 1053, 
    FR_MaxProjectNumberExceeded   = 1054, 
    FR_AttributeNotFound          = 1055, 
    FR_AttributeConversionFailed  = 1056, 
    FR_UnknownError               = 1100,

    // --- FlashStatus Errors ---
    FS_LicenseIsNotAvailable                      = 2009,     
    FS_Aborted                                    = 2010,  
    FS_UnknownError                               = 2011,  
    FS_ProcessingFlashwareFailed                  = 2015,  
    FS_InitializingCommunicationFailed            = 2016, 
    FS_StopReprogrammingFailed                    = 2017,  
    FS_ProjectDataInvalid                         = 2018,  
    FS_InitializingFlashLibraryFailed             = 2019, 
    FS_ScriptVersionMismatch                      = 2020, 
    FS_LoadingProjectFailed                       = 2021, 
    FS_FlashwareChanged                           = 2022, 
    FS_ReadingExpectedIdentsFailed                = 2023, 
    FS_ForceBootModeFailed                        = 2024,  
    FS_SwitchBaudrateFailed                       = 2025, 
    FS_SendWakeUpPatternFailed                    = 2026, 
    FS_GeneralScriptFailure                       = 2040,  
    FS_SeedKeyHandlingFailed                      = 2041,  
    FS_SecurityAccessFailed                       = 2042, 
    FS_CommunicationFailed                        = 2043,   
    FS_DiagnosticTransactionFailed                = 2044, 
    FS_SoftwareIntegrityCheckFailed               = 2045, 
    FS_NegativeResponseReceived                   = 2046,  
    FS_EraseMemoryFailed                          = 2047,  
    FS_SoftwareAuthenticityCheckFailed            = 2048, 
    FS_SoftwareCompatibilityCheckFailed           = 2049,  
    FS_FingerprintCheckFailed                     = 2050, 
    FS_HardwareCompatibilityCheckFailed           = 2051, 
    FS_ProgrammingPreconditionsCheckFailed        = 2052, 
    FS_InvalidParameterDetected                   = 2053,   
    FS_GeneralCustomActionFailure                 = 2060,  
    FS_CustomActionAttributeConversionFailed      = 2061,   
    FS_ReportingFailure                           = 2080   
  };
}

// --- Helper Function ---
void LogvFlashError(char contextName[])
{
  char errorText[2048];
  TestWaitForvFlashLastErrorMessage(errorText, elcount(errorText));
  TestStepFail(contextName, "Error occurred: %s", errorText);
}
  
/*
 This function could be to program vflashpack successfully.
*/
enum vFlashStatusCode TestWaitForvFlashPackReprogrammed(char flashpack[])
{
  enum vFlashStatusCode status;

  if(flashpack[0] == 0) 
  { 
    TestStepFail("vFlash Init", "No path to flashpack given!");
    return FR_FileNotFound;
  }
  
  TestStep("vFlash Sequence", "Initialize vFlash Library");
  if ((status = (enum vFlashStatusCode)TestWaitForvFlashInitialized()) != Success) 
  { 
    LogvFlashError("Init"); 
    return status; 
  }
  
  TestStep("vFlash Sequence", "Load vFlashpack: %s", flashpack);
  if ((status = (enum vFlashStatusCode)TestWaitForvFlashProjectLoaded(flashpack)) != Success) 
  { 
    LogvFlashError("Load"); 
    return status; 
  }
  
  TestStep("vFlash Sequence", "Activate Network");
  if ((status = (enum vFlashStatusCode)TestWaitForvFlashNetworkActivated()) != Success) 
  { 
    LogvFlashError("Network"); 
    TestWaitForvFlashProjectUnloaded(); // Clean up project
    TestWaitForvFlashDeinitialized();   // Clean up initialization
    return status;
  }
  
  TestStep("vFlash Sequence", "Start Flashing");
  status = (enum vFlashStatusCode)TestWaitForvFlashReprogrammed();
  if (status != Success) 
  {
    LogvFlashError("Flashing");
  }
  else 
  {
    TestStepPass("vFlash Sequence", "ECU reprogrammed successfully");
  }
  
  // Final Teardown - Executes if Flashing succeeds or fails
  TestStep("vFlash Sequence", "Unload and Deinitialize");
  TestWaitForvFlashProjectUnloaded();
  TestWaitForvFlashDeinitialized();
  
  return status;
}

/*
 This function could be used when testing corrupted vflashpack - Application/Checksum/Signature corrupted files
*/
enum vFlashStatusCode TestWaitForCorruptedvFlashPackReprogrammed(char flashpack[], char expected_error_text[])
{
  enum vFlashStatusCode lastStatusCode;
  char errorText[2048];
  int hasProjectLoaded = 0;
  int expectedErrorFound = 0;
  
  if(flashpack[0] == 0) 
  { 
    TestStepFail("vFlash Init", "No path to flashpack given!");
    return FR_FileNotFound;
  }
  
  TestStep("vFlash Sequence", "Initialize vFlash Library");
  lastStatusCode = (enum vFlashStatusCode) TestWaitForvFlashInitialized();
  if (lastStatusCode != Success) 
  {
	  TestWaitForvFlashLastErrorMessage(errorText, elcount(errorText));
  } 
  else 
  {
    TestStep("vFlash Sequence", "Load vFlashpack: %s", flashpack);
    lastStatusCode = (enum vFlashStatusCode) TestWaitForvFlashProjectLoaded(flashpack);
    if (lastStatusCode != Success) 
    {
      TestWaitForvFlashLastErrorMessage(errorText, elcount(errorText));
    } 
    else 
    {
      hasProjectLoaded = 1;
      TestStep("vFlash Sequence", "Activate Network");
      lastStatusCode = (enum vFlashStatusCode) TestWaitForvFlashNetworkActivated();
      if (lastStatusCode != Success) 
      {
        TestWaitForvFlashLastErrorMessage(errorText, elcount(errorText));
      } 
      else 
      {
        TestStep("vFlash Sequence", "Start Flashing (Expecting Failure)");
        lastStatusCode = (enum vFlashStatusCode) TestWaitForvFlashReprogrammed();
        if (lastStatusCode == Success) 
        {
          TestStepFail("Error Check", "ECU reprogrammed successfully, but failure was expected.");
        } 
        else 
        {
          TestWaitForvFlashLastErrorMessage(errorText, elcount(errorText));
        }
      }
    }
  }
  // Validate if the error we caught matches the error we wanted
  if (lastStatusCode != Success) 
  {
    if (strstr(errorText, expected_error_text) != -1) 
    {
      TestStepPass("Error Check", "Caught expected error: %s", errorText);
      expectedErrorFound = 1;
    } 
    else 
    {
      TestStepFail("Error Check", "Unexpected Error occurred: %s (Expected: %s)", errorText, expected_error_text);
    }
  }

  TestStep("vFlash Sequence", "Unload and Deinitialize");
  if(hasProjectLoaded) 
  {
    TestWaitForvFlashProjectUnloaded();
  }
  TestWaitForvFlashDeinitialized();

  // Return Success if the expected error was found, meaning the negative test "passed"
  return expectedErrorFound ? Success : lastStatusCode;
}
